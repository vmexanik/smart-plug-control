## main/Kconfig.projbuild
```kconfig
menu "Smart Plug Control"

    menu "Default trigger input GPIOs"
        comment "Runtime web UI can change enable/disable and invert; these are the physical pin defaults on first boot."
        comment "Defaults below target ESP32-S3-WROOM-1-N16R8 (Octal PSRAM). If building for a classic ESP32-WROOM-32 instead, GPIO34/35/32 (input-only, no pull resistor) are the traditional choice there and remain valid -- just change these back."
        comment "AC1 is NOT in this list -- it has no physical GPIO on this board revision. AC1 is a virtual trigger driven entirely by the AC mains monitor's in-band status (see the 'AC mains monitor (ZMPT101B)' menu below and ac_monitor.c/plug_manager.c) -- its wiring is analog only (ZMPT101B -> ADC pin), there is no separate digital opto line for it any more."

        config INPUT_DC1_GPIO_DEFAULT
            int "DC1 default GPIO"
            default 7
            range 0 48
            help
                On ESP32-S3-WROOM-1 with Octal PSRAM (the "R8" modules,
                e.g. N16R8), GPIO26-37 are wired to flash/PSRAM and GPIO19/
                20 are USB-JTAG, GPIO43/44 are the default console UART,
                GPIO0/3/45/46 are strapping pins -- none of those are usable
                here. GPIO4-18, 21, 38-42, 47, 48 are free. (On classic
                ESP32-WROOM-32 the valid range is 0-39, input-only above 34.)

        config INPUT_DC2_GPIO_DEFAULT
            int "DC2 default GPIO"
            default 2
            range 0 48

        config INPUT_POLL_INTERVAL_MS_DEFAULT
            int "Input poll interval (ms)"
            default 100
            range 10 5000
            help
                How often gpio_inputs.c re-reads the trigger input levels.
                Not editable from the web UI (physical timing constant).
    endmenu

    config WEB_HTTP_PORT
        int "Web UI / REST API HTTP port"
        default 80

    config AP_FALLBACK_SSID_PREFIX
        string "Fallback AP SSID prefix"
        default "SmartPlug-"

    config AP_FALLBACK_PASSWORD
        string "Fallback AP password (min 8 chars)"
        default "plugsetup"

    config NTP_SERVER_DEFAULT
        string "NTP server (empty = disable automatic time sync)"
        default "pool.ntp.org"
        help
            Not editable from the web UI -- change here and reflash if you
            need a different server (e.g. a LAN-local NTP server). The web
            UI still allows setting the clock manually via POST /api/time,
            which is independent of this setting.

    menu "Network scan / device fingerprinting"
        config FINGERPRINT_HTTP_TIMEOUT_MS
            int "HTTP timeout per fingerprint request (ms)"
            default 800
            range 200 5000
            help
                Applies to each request in the Shelly/Tasmota/ESPHome
                detection cascade (see fingerprint.c). Runs sequentially
                against every host the scan found with TCP:80 open, so
                keep this short -- a handful of unresponsive candidates at
                a high timeout noticeably slows the scan down.

        config FINGERPRINT_ENABLE_ESPHOME
            bool "Attempt ESPHome detection"
            default y
            help
                Adds a "GET /" heuristic (body contains "ESPHome") plus a
                best-effort scan of the response HTML for a /switch/<id>/
                entity to build a control URL. ESPHome's web_server
                component must be enabled in the device's own YAML config
                and must expose a switch entity for this to find anything
                -- ESPHome's native API (port 6053, protobuf) is not
                implemented, see README.
    endmenu

    menu "AC mains monitor (ZMPT101B)"
        config AC_MON_ADC_GPIO_DEFAULT
            int "AC mains monitor ADC input GPIO (this is the 'AC1' pin)"
            default 10
            range 1 10
            help
                ZMPT101B output pin. zmpt101b.c uses adc_continuous (DMA),
                which on ESP32-S3 works only on ADC1 = GPIO1-10
                (channel = GPIO - 1). Default GPIO10 = ADC1_CH9. If the
                board is routed to GPIO11 (ADC2), bridge GPIO11 to GPIO10.

        config AC_MON_VOLTS_PER_RMS_MV_X10000
            int "Calibration: volts of mains per millivolt RMS, x10000"
            default 7667
            range 1 1000000
            help
                Factory default for the AC voltage coefficient: volts of
                mains per millivolt RMS at the ADC pin (after adc_cali).
                Kconfig has no float type, so this is the real coefficient
                multiplied by 10000 (7667 = 0.7667). 7667 corresponds to
                0.3 V RMS at the ADC pin for 230 V mains (230 / 300 mV).

                The real value is set from the web UI (voltmeter
                calibration) and stored in settings; this is only used
                until that is done or after a calibration reset.
    endmenu

    menu "Status LED"
        config LED_STATUS_GPIO_DEFAULT
            int "Status LED GPIO"
            default 12
            range 0 48
            help
                Blinks once per second (500ms on/off) for as long as the
                firmware is alive -- see led_status.c. Free, general-purpose
                GPIO, not shared with flash/PSRAM, USB-JTAG, console UART or
                any strapping pin.
    endmenu

endmenu
```
